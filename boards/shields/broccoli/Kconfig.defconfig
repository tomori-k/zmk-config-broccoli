## boards/shields/broccoli/Kconfig.defconfig
```kconfig
if SHIELD_BROCCOLI_RIGHT

config ZMK_KEYBOARD_NAME
    default "broccoli"

config ZMK_SPLIT_ROLE_CENTRAL
    default y

config ZMK_POINTING
    default y

config PMW3610
    default y

config PMW3610_REPORT_INTERVAL_MIN
    default 12

config PMW3610_INVERT_X
    default y

endif # SHIELD_BROCCOLI_RIGHT

if SHIELD_BROCCOLI_LEFT || SHIELD_BROCCOLI_RIGHT

config ZMK_SPLIT
    default y

config SPI
    default y

endif # SHIELD_BROCCOLI_LEFT || SHIELD_BROCCOLI_RIGHT
```

## boards/shields/broccoli/Kconfig.shield
```kconfig
config SHIELD_BROCCOLI_LEFT
    def_bool $(shields_list_contains,broccoli_left)

config SHIELD_BROCCOLI_RIGHT
    def_bool $(shields_list_contains,broccoli_right)
```

## config/west.yml
```yaml
manifest:
  defaults:
    revision: v0.3
  remotes:
    - name: zmkfirmware
      url-base: https://github.com/zmkfirmware
    # Additional modules containing boards/shields/custom code can be listed here as well
    # See https://docs.zephyrproject.org/3.2.0/develop/west/manifest.html#projects
    - name: tomori-k
      url-base: https://github.com/tomori-k
  projects:
    - name: zmk
      remote: zmkfirmware
      import: app/west.yml
    - name: zmk-pmw3610-driver
      remote: tomori-k
      revision: rotate30
    - name: zmk-behavior-auto-capsword
      remote: tomori-k
      revision: v2025.12.24
  self:
    path: config
```
